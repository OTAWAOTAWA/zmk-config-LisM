## config/west.yml
```yaml
manifest:
  remotes:
    - name: zmkfirmware
      url-base: https://github.com/zmkfirmware
    - name: sekigon-gonnoc
      url-base: https://github.com/sekigon-gonnoc
    - name: caksoylar
      url-base: https://github.com/caksoylar
    - name: 4mplelab
      url-base: https://github.com/4mplelab
    - name: cormoran
      url-base: https://github.com/cormoran
      
    - name: prospector
      url-base: https://github.com/t-ogura
      
  projects:
    - name: zmk
      remote: cormoran
      revision: v0.3-branch+dya
      import: app/west.yml
    - name: zmk-driver-paw3222
      remote: sekigon-gonnoc
      revision: main
    - name: zmk-rgbled-widget
      remote: caksoylar
      revision: main
    - name: zmk-feature-charge-indicator
      remote: 4mplelab
      revision: main

    - name: zmk-module-ble-management
      remote: cormoran
      revision: main
    - name: zmk-module-battery-history
      remote: cormoran
      revision: main
    - name: zmk-module-settings-rpc
      remote: cormoran
      revision: main
    - name: zmk-module-runtime-input-processor
      remote: cormoran
      revision: main
    - name: zmk-behavior-runtime-sensor-rotate
      remote: cormoran
      revision: main

    - name: prospector-zmk-module
      remote: prospector
      revision: v2.0.0  # Use specific version tag
      path: modules/prospector-zmk-module
      
  self:
    path: config
```
